## Chapter06/buildroot/package/helloworld/Config.in
```kconfig
config BR2_PACKAGE_HELLOWORLD
	bool "helloworld"
	help
	  A friendly program that prints Hello World! every 10s
```

## Chapter07/meta-gattd/conf/layer.conf
```bitbake
# We have a conf and classes directory, add to BBPATH
BBPATH .= ":${LAYERDIR}"

# We have recipes-* directories, add to BBFILES
BBFILES += "${LAYERDIR}/recipes-*/*/*.bb \
            ${LAYERDIR}/recipes-*/*/*.bbappend"

BBFILE_COLLECTIONS += "meta-gattd"
BBFILE_PATTERN_meta-gattd = "^${LAYERDIR}/"
BBFILE_PRIORITY_meta-gattd = "6"

LAYERDEPENDS_meta-gattd = "core"
LAYERSERIES_COMPAT_meta-gattd = "dunfell"
```

## Chapter07/meta-mackerel/conf/distro/mackerel.conf
```bitbake
DISTRO_NAME = "Mackerel (Mackerel Embedded Linux Distro)"
DISTRO_VERSION = "0.1"

PACKAGE_CLASSES ?= "package_ipk"
```

## Chapter07/meta-mackerel/conf/layer.conf
```bitbake
# We have a conf and classes directory, add to BBPATH
BBPATH .= ":${LAYERDIR}"

# We have recipes-* directories, add to BBFILES
BBFILES += "${LAYERDIR}/recipes-*/*/*.bb \
            ${LAYERDIR}/recipes-*/*/*.bbappend"

BBFILE_COLLECTIONS += "meta-mackerel"
BBFILE_PATTERN_meta-mackerel = "^${LAYERDIR}/"
BBFILE_PRIORITY_meta-mackerel = "6"

LAYERDEPENDS_meta-mackerel = "core"
LAYERSERIES_COMPAT_meta-mackerel = "dunfell"
```

## Chapter07/meta-mine/conf/layer.conf
```bitbake
# We have a conf and classes directory, add to BBPATH
BBPATH .= ":${LAYERDIR}"

# We have recipes-* directories, add to BBFILES
BBFILES += "${LAYERDIR}/recipes-*/*/*.bb \
            ${LAYERDIR}/recipes-*/*/*.bbappend"

BBFILE_COLLECTIONS += "meta-mine"
BBFILE_PATTERN_meta-mine = "^${LAYERDIR}/"
BBFILE_PRIORITY_meta-mine = "6"

LAYERDEPENDS_meta-mine = "core"
LAYERSERIES_COMPAT_meta-mine = "dunfell"
```

## Chapter10/meta-ota/conf/layer.conf
```bitbake
# We have a conf and classes directory, add to BBPATH
BBPATH .= ":${LAYERDIR}"

# We have recipes-* directories, add to BBFILES
BBFILES += "${LAYERDIR}/recipes-*/*/*.bb \
	${LAYERDIR}/recipes-*/*/*.bbappend"

BBFILE_COLLECTIONS += "ota"
BBFILE_PATTERN_ota = "^${LAYERDIR}/"
BBFILE_PRIORITY_ota = "6"
```

## Chapter20/buildroot/package/bcc/Config.in
```kconfig
config BR2_PACKAGE_BCC
	bool "bcc"
	depends on BR2_PACKAGE_LLVM_ARCH_SUPPORTS
	depends on BR2_TOOLCHAIN_USES_GLIBC # hardcode GNU tuple (x86_64-unknown-linux-gnu)
	depends on BR2_TOOLCHAIN_GCC_AT_LEAST_4_8 # clang
	depends on BR2_TOOLCHAIN_HAS_THREADS # clang
	depends on BR2_INSTALL_LIBSTDCPP # clang
	select BR2_PACKAGE_CLANG
	select BR2_PACKAGE_ELFUTILS
	select BR2_PACKAGE_LLVM_BPF
	select BR2_PACKAGE_PYTHON3
	select BR2_PACKAGE_FLEX
	select BR2_PACKAGE_TAR
	help
	  BPF Compiler Collection (BCC)

	  BCC is a toolkit for creating efficient kernel tracing and
	  manipulation programs, and includes several useful tools and
	  examples. It makes use of extended BPF (Berkeley Packet
	  Filters), formally known as eBPF, a new feature that was
	  first added to Linux 3.15. Much of what BCC uses requires
	  Linux 4.1 and above.

	  Note: Before using bcc, you need either need to :
	  - For kernel_ver = [4.1, 5.2) : Copy kernel source code
	  to target folder /lib/module/<kernel_ver>/build.
	  - Or kernel_ver >= 5.2 : Compile kernel with CONFIG_IKHEADERS
	  and use generated headers under /sys/kernel/kheaders.tar.xz
	  to populate /lib/module/<kernel_ver>/build.

	  That's because the clang frontend build eBPF code at runtime.

	  https://github.com/iovisor/bcc
	  https://ebpf.io

comment "bcc needs a glibc toolchain w/ wchar, threads, C++, gcc >= 4.8, host gcc >= 4.8"
	depends on BR2_PACKAGE_LLVM_ARCH_SUPPORTS
	depends on !BR2_TOOLCHAIN_USES_GLIBC || !BR2_TOOLCHAIN_HAS_THREADS \
	|| !BR2_INSTALL_LIBSTDCPP
```
